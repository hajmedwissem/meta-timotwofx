## conf/layer.conf
```bitbake
# We have a conf and classes directory, add to BBPATH
BBPATH .= ":${LAYERDIR}"

# We have recipes-* directories, add to BBFILES
BBFILES += "${LAYERDIR}/recipes-*/*/*.bb \
            ${LAYERDIR}/recipes-*/*/*.bbappend"

BBFILE_COLLECTIONS += "meta-timotwofx"
BBFILE_PATTERN_meta-timotwofx = "^${LAYERDIR}/"
BBFILE_PRIORITY_meta-timotwofx = "6"

LAYERDEPENDS_meta-timotwofx = "core"
LAYERSERIES_COMPAT_meta-timotwofx = "walnascar"
```
